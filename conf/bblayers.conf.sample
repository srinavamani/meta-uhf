## conf/bblayers.conf.sample
```bitbake
# POKY_BBLAYERS_CONF_VERSION is increased each time build/conf/bblayers.conf
# changes incompatibly
POKY_BBLAYERS_CONF_VERSION = "2"

BBPATH = "${TOPDIR}"
BBFILES ?= ""

BBLAYERS ?= " \
    ${HOME}/poky/meta \
    ${HOME}/poky/meta-poky \
    ${HOME}/meta-openembedded/meta-oe \
    ${HOME}/meta-openembedded/meta-multimedia \
    ${HOME}/meta-openembedded/meta-networking \
    ${HOME}/meta-openembedded/meta-perl \
    ${HOME}/meta-openembedded/meta-python \
    ${HOME}/meta-raspberrypi \
    ${HOME}/meta-rpi \
"
```

## conf/layer.conf
```bitbake
# We have a conf and classes directory, append to BBPATH
BBPATH .= ":${LAYERDIR}"

# We have a recipes directory, add to BBFILES
BBFILES += "${LAYERDIR}/recipes*/*/*.bb ${LAYERDIR}/recipes*/*/*.bbappend ${LAYERDIR}/images/*.bb"

BBFILE_COLLECTIONS += "meta-uhf"
BBFILE_PATTERN_meta-uhf := "^${LAYERDIR}/"
BBFILE_PRIORITY_meta-uhf = "17"

LAYERSERIES_COMPAT_meta-uhf = "warrior"
```
